## lossless_tx/sdkconfig.defaults
```kconfig
CONFIG_USB_DEVICE_UAC_AS_PART=y
CONFIG_UAC_SPEAKER_CHANNEL_NUM=2
CONFIG_UAC_MIC_CHANNEL_NUM=1
CONFIG_UAC_SAMPLE_RATE=48000
CONFIG_UAC_BIT_RESOLUTION=16
CONFIG_UAC_BYTES_PER_SAMPLE=2
CONFIG_UAC_SPK_INTERVAL_MS=10
CONFIG_UAC_MIC_INTERVAL_MS=10
CONFIG_UAC_SPK_NEW_PLAY_INTERVAL=1000
CONFIG_UAC_TINYUSB_TASK_PRIORITY=5
CONFIG_UAC_TINYUSB_TASK_CORE=0
CONFIG_UAC_SPK_TASK_PRIORITY=5
CONFIG_UAC_SPK_TASK_CORE=0
```
